VERSION ""

NS_ :

BS_:

BU_: MM5

BO_ 380 MM5_02: 8 MM5
 SG_ Az_MM5 : 32|16@1+ (-0.0001274,4.17464) [0|0] "" Vector__XXX

BO_ 376 MM5_01: 8 MM5
 SG_ Ax_MM5 : 32|16@1+ (-0.0001274,4.2) [0|0] "" Vector__XXX
 SG_ Roll_Rate_MM5 : 0|16@1+ (-0.005,163.9) [0|0] "" Vector__XXX

BO_ 372 MM5_00: 8 MM5
 SG_ Ay_MM5 : 32|16@1+ (-0.0001274,4.17464) [0|0] "" Vector__XXX
 SG_ Yaw_Rate_MM5 : 0|16@1+ (0.005,-163.9) [-163.9|163.775] "" Vector__XXX
