VERSION ""

NS_ :

BS_:

BU_: M400_Data2_send

BO_ 1519 M400_Data2_send: 8 M400_Data2_send
 SG_ Gear_Det m14 : 39|16@0- (1,0) [0|0] "" Vector__XXX
 SG_ Gear m14 : 23|16@0- (1,0) [0|0] "" Vector__XXX
 SG_ Fuel_Actual_Pulse_W m13 : 55|16@0- (0.002,0) [-65.536|65.534] "" Vector__XXX
 SG_ Fuel_Inj_Duty_Cycle m13 : 39|16@0- (0.1,0) [-3276.8|3276.7] "" Vector__XXX
 SG_ Fuel_Overall_Trim m13 : 23|16@0- (0.1,0) [-3276.8|3276.7] "" Vector__XXX
 SG_ Fuel_4_Indiv_Trim m12 : 55|16@0- (1,0) [-32768|32767] "" Vector__XXX
 SG_ Fuel_3_Indiv_Trim m12 : 39|16@0- (1,0) [-32768|32767] "" Vector__XXX
 SG_ Fuel_2_Indiv_Trim m12 : 23|16@0- (1,0) [-32768|32767] "" Vector__XXX
 SG_ Fuel_1_Indiv_Trim m11 : 55|16@0- (1,0) [-32768|32767] "" Vector__XXX
 SG_ Ignition_Advance m11 : 39|16@0- (0.1,0) [-3276.8|3276.7] "" Vector__XXX
 SG_ Ign_4_Advance m11 : 23|16@0- (0.1,0) [-3276.8|3276.7] "" Vector__XXX
 SG_ Ign_3_Advance m10 : 55|16@0- (0.1,0) [-3276.8|3276.7] "" Vector__XXX
 SG_ Ign_2_Advance m10 : 39|16@0- (0.1,0) [-3276.8|3276.7] "" Vector__XXX
 SG_ Ign_1_Advance m10 : 23|16@0- (0.1,0) [-3276.8|3276.7] "" Vector__XXX
 SG_ Fuel_Temp m9 : 55|16@0- (0.1,0) [-3276.8|3276.7] "" Vector__XXX
 SG_ La1_Short_Term_Trim m9 : 39|16@0- (0.1,0) [-3276.8|3276.7] "" Vector__XXX
 SG_ La1_Long_Term_Trim m9 : 23|16@0- (0.1,0) [-3276.8|3276.7] "" Vector__XXX
 SG_ La1_Aim_Value m8 : 55|16@0- (0.001,0) [-32.768|32.767] "" Vector__XXX
 SG_ Lambda_1 m8 : 39|16@0- (0.001,0) [-32.768|32.767] "" Vector__XXX
 SG_ Fuel_Cut_Level_Total m8 : 23|16@0- (0.1,0) [-3276.8|3276.7] "" Vector__XXX
 SG_ Exhaust_Gas_Temp_4 m7 : 55|16@0- (1,0) [0|0] "" Vector__XXX
 SG_ Exhaust_Gas_Temp_3 m7 : 39|16@0- (1,0) [0|0] "" Vector__XXX
 SG_ Exhaust_Gas_Temp_2 m7 : 23|16@0- (1,0) [0|0] "" Vector__XXX
 SG_ Exhaust_Gas_Temp_1 m6 : 55|16@0- (1,0) [0|0] "" Vector__XXX
 SG_ Manifold_Pressure m6 : 39|16@0- (0.1,0) [-3276.8|3276.7] "" Vector__XXX
 SG_ Throttle_Position m6 : 23|16@0- (0.1,0) [-3276.8|3276.7] "" Vector__XXX
 SG_ Oil_Temp m5 : 55|16@0- (0.1,0) [-3276.8|3276.7] "" Vector__XXX
 SG_ Oil_Pressure m5 : 39|16@0- (0.1,0) [-3276.8|3276.7] "" Vector__XXX
 SG_ Inlet_Air_Temp m5 : 23|16@0- (0.1,0) [-3276.8|3276.7] "" Vector__XXX
 SG_ Fuel_Pressure m4 : 55|16@0- (0.1,0) [-3276.8|3276.7] "" Vector__XXX
 SG_ Engine_Temp m4 : 39|16@0- (0.1,0) [-3276.8|3276.7] "" Vector__XXX
 SG_ Steering_Angle_Sensor m4 : 23|16@0- (0.1,0) [-3276.8|3276.7] "" Vector__XXX
 SG_ ECU_Internal_Temp m3 : 55|16@0- (0.1,0) [-3276.8|3276.7] "" Vector__XXX
 SG_ ECU_CPU_Usage m3 : 39|16@0- (0.1,0) [-3276.8|3276.7] "" Vector__XXX
 SG_ Aux_8_Out_Duty_Cycle m3 : 23|16@0- (1,0) [0|0] "" Vector__XXX
 SG_ Aux_7_Out_Duty_Cycle m2 : 55|16@0- (1,0) [0|0] "" Vector__XXX
 SG_ Aux_6_Out_Duty_Cycle m2 : 39|16@0- (1,0) [0|0] "" Vector__XXX
 SG_ Aux_5_Out_Duty_Cycle m2 : 23|16@0- (1,0) [0|0] "" Vector__XXX
 SG_ Aux_4_Out_Duty_Cycle m1 : 55|16@0- (1,0) [0|0] "" Vector__XXX
 SG_ Aux_3_Out_Duty_Cycle m1 : 39|16@0- (1,0) [0|0] "" Vector__XXX
 SG_ Aux_2_Out_Duty_Cycle m1 : 23|16@0- (1,0) [0|0] "" Vector__XXX
 SG_ Aux_1_Out_Duty_Cycle m0 : 55|16@0- (1,0) [0|0] "" Vector__XXX
 SG_ RPM m0 : 39|16@0- (1,0) [0|0] "" Vector__XXX
 SG_ Battery_Voltage m0 : 23|16@0- (0.01,0) [-327.68|327.67] "" Vector__XXX
 SG_ rowcounter M : 0|8@1+ (1,0) [0|255] "" Vector__XXX
