VERSION ""

NS_ :

BS_:

BU_: M400_Data_set_1_send

BO_ 1520 M400_Data_set_1_send: 8 M400_Data_set_1_send
 SG_ Gear_Sensor_Voltage m4 : 55|16@0- (0.001,0) [-32.768|32.767] "" Vector__XXX
 SG_ Gear_Angle m4 : 39|16@0- (0.072,0) [-2359.296|2359.224] "" Vector__XXX
 SG_ Ign_Cut_Level_Total m4 : 23|16@0- (1,0) [-32768|32767] "" Vector__XXX
 SG_ Wheel_Slip m3 : 55|16@0- (0.1,0) [-3276.8|3276.7] "" Vector__XXX
 SG_ TC_Slip_Aim_Value m3 : 39|16@0- (0.1,0) [-3276.8|3276.7] "" Vector__XXX
 SG_ TC_Slip_Aim_Error m3 : 23|16@0- (0.1,0) [-3276.8|3276.7] "" Vector__XXX
 SG_ TC_Power_Reduction m2 : 55|16@0- (0.1,0) [-3276.8|3276.7] "" Vector__XXX
 SG_ TC_Launch_Aim_RPM m2 : 39|16@0- (1,0) [-32768|32767] "" Vector__XXX
 SG_ TC_Ign_Retard m2 : 23|16@0- (1,0) [-32768|32767] "" Vector__XXX
 SG_ Ground_Speed_Right m1 : 55|16@0- (0.1,0) [-3276.8|3276.7] "" Vector__XXX
 SG_ Drive_Speed_Right m1 : 39|16@0- (0.1,0) [-3276.8|3276.7] "" Vector__XXX
 SG_ Ground_Speed_Left m1 : 23|16@0- (0.1,0) [-3276.8|3276.7] "" Vector__XXX
 SG_ Ground_Speed_M400 m0 : 39|16@0- (0.1,0) [-3276.8|3276.7] "" Vector__XXX
 SG_ Drive_Speed_Left m0 : 55|16@0- (0.1,0) [-3276.8|3276.7] "" Vector__XXX
 SG_ Drive_Speed_M400 m0 : 23|16@0- (0.1,0) [-3276.8|3276.7] "" Vector__XXX
 SG_ rowcounter M : 0|8@1+ (1,0) [0|255] "" Vector__XXX
