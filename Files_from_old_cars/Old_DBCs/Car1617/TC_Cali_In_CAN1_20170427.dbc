VERSION ""

NS_ :

BS_:

BU_: DDU7_EGT_send

BO_ 104 TC_Cali_In_CAN1: 8 DDU7_EGT_send
 SG_ TC_AxleThrust_feedforward_cali m1 : 23|16@0- (0.01,0) [-327.68|327.67] "" Vector__XXX
 SG_ TC_D_mainPID m0 : 55|16@0- (0.01,0) [-327.68|327.67] "" Vector__XXX
 SG_ TC_P_mainPID m0 : 39|16@0- (0.01,0) [-327.68|327.67] "" Vector__XXX
 SG_ TC_I_mainPID m0 : 23|16@0- (0.01,0) [-327.68|327.67] "" Vector__XXX
 SG_ rowcounter M : 0|8@1+ (1,0) [0|255] "" Vector__XXX
