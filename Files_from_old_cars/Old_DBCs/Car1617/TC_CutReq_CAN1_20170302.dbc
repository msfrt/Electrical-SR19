VERSION ""

NS_ :

BS_:

BU_: DDU7_EGT_send

BO_ 105 TC_CutReq_CAN1: 8 DDU7_EGT_send
 SG_ slAxle_tar_req m0 : 55|16@0- (0.01,0) [-327.68|327.67] "" Vector__XXX
 SG_ slAxle_req m0 : 39|16@0- (0.01,0) [-327.68|327.67] "" Vector__XXX
 SG_ TC_Torque_reduction_req m0 : 23|16@0- (0.1,0) [-3276.8|3276.7] "" Vector__XXX
 SG_ rowcounter M : 0|8@1+ (1,0) [0|255] "" Vector__XXX
