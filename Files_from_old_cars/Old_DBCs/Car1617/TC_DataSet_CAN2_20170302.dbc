VERSION ""

NS_ :

BS_:

BU_: DDU7_EGT_send

BO_ 26 TC_DataSet_CAN2: 8 Vector__XXX
 SG_ v_RR_filtered_TC m5 : 39|16@0- (0.01,0) [-327.68|327.67] "" Vector__XXX
 SG_ v_RL_filtered_TC m8 : 55|16@0- (0.01,0) [-327.68|327.67] "" Vector__XXX
 SG_ v_RAxle m8 : 39|16@0- (0.01,0) [-327.68|327.67] "" Vector__XXX
 SG_ v_FR_filtered_TC m8 : 23|16@0- (0.01,0) [-327.68|327.67] "" Vector__XXX
 SG_ v_FL_filtered_TC m7 : 55|16@0- (0.01,0) [-327.68|327.67] "" Vector__XXX
 SG_ v_FAxle m7 : 39|16@0- (0.01,0) [-327.68|327.67] "" Vector__XXX
 SG_ TC_Torque_reduction_log m7 : 23|16@0- (0.01,0) [-327.68|327.67] "" Vector__XXX
 SG_ TC_PID_P_product m6 : 55|16@0- (0.01,0) [-327.68|327.67] "" Vector__XXX
 SG_ TC_PID_output m6 : 39|16@0- (0.01,0) [-327.68|327.67] "" Vector__XXX
 SG_ TC_PID_I_product m6 : 23|16@0- (0.01,0) [-327.68|327.67] "" Vector__XXX
 SG_ TC_PID_D_product m5 : 55|16@0- (0.01,0) [-327.68|327.67] "" Vector__XXX
 SG_ SR_Axle m5 : 23|16@0- (0.01,0) [-327.68|327.67] "" Vector__XXX
 SG_ slAxle_tar m4 : 55|16@0- (0.01,0) [-327.68|327.67] "" Vector__XXX
 SG_ slAxle_error m4 : 39|16@0- (0.01,0) [-327.68|327.67] "" Vector__XXX
 SG_ slAxle m4 : 23|16@0- (0.01,0) [-327.68|327.67] "" Vector__XXX
 SG_ muX_achieved m3 : 55|16@0- (0.01,0) [-327.68|327.67] "" Vector__XXX
 SG_ mu_est m3 : 39|16@0- (0.01,0) [-327.68|327.67] "" Vector__XXX
 SG_ Fz_RAxle m3 : 23|16@0- (0.1,0) [-3276.8|3276.7] "" Vector__XXX
 SG_ Fz_FAxle m2 : 55|16@0- (0.1,0) [-3276.8|3276.7] "" Vector__XXX
 SG_ Ay_filtered_TC m2 : 39|16@0- (0.01,0) [-327.68|327.67] "" Vector__XXX
 SG_ AxleThrust_Ricardo m2 : 23|16@0- (0.1,0) [-3276.8|3276.7] "" Vector__XXX
 SG_ AxleThrust_MaxMueTarget m1 : 55|16@0- (0.1,0) [-3276.8|3276.7] "" Vector__XXX
 SG_ AxleThrust_MaxMuePercentError m1 : 39|16@0- (0.1,0) [-3276.8|3276.7] "" Vector__XXX
 SG_ AxleThrust_MaxMueError m1 : 23|16@0- (0.1,0) [-3276.8|3276.7] "" Vector__XXX
 SG_ AxleThrust_Dyno m0 : 55|16@0- (0.1,0) [-3276.8|3276.7] "" Vector__XXX
 SG_ AxleThrust_Ax m0 : 39|16@0- (0.1,0) [-3276.8|3276.7] "" Vector__XXX
 SG_ Ax_filtered_TC m0 : 23|16@0- (0.01,0) [-327.68|327.67] "" Vector__XXX
 SG_ rowcounter M : 0|8@1+ (1,0) [0|255] "" Vector__XXX
