VERSION ""

NS_ :

BS_:

BU_: YRS3_Receive

BO_ 128 YRS3_Receive_01: 8 YRS3_Receive
 SG_ Ax_YRS3 : 32|16@1+ (0.0001274,-4.17464) [-4.17464|4.174519] "" Vector__XXX
 SG_ Yaw_Angular_Acceleration : 0|16@1+ (-0.125,4096) [-4096|4095.875] "" Vector__XXX

BO_ 112 YRS3_Receive_00: 8 YRS3_Receive
 SG_ Ay_YRS3 : 32|16@1+ (-0.0001274,4.17464) [-4.17464|4.174519] "" Vector__XXX
 SG_ Yaw_Rate : 0|16@1+ (-0.005,163.84) [-163.84|163.835] "" Vector__XXX
