VERSION ""

NS_ :

BS_:

BU_: Car1516_SGTCC

BO_ 98 SGTCC_Front_02: 8 Car1516_SGTCC
 SG_ TC_Front_2 : 16|16@1- (0.1,0) [0|0] "" Vector__XXX
 SG_ TC_Front_1 : 0|16@1- (0.1,0) [0|0] "" Vector__XXX

BO_ 103 SGTCC_Rear_02: 8 Car1516_SGTCC
 SG_ TC_Rear_2 : 16|16@1- (0.1,0) [-3276.8|3276.7] "" Vector__XXX
 SG_ TC_Rear_1 : 0|16@1- (0.1,0) [0|0] "" Vector__XXX

BO_ 101 SGTCC_Rear_00: 8 Car1516_SGTCC
 SG_ SG_RRPR : 16|16@1- (0.50052,-826.363) [-17227.40236|15574.17584] "" Vector__XXX
 SG_ SG_RLPR : 0|16@1- (0.50052,-836.874) [-17237.91336|15563.66484] "" Vector__XXX

BO_ 96 SGTCC_Front_00: 8 Car1516_SGTCC
 SG_ SG_FRPR : 16|16@1- (0.52474,-879.4) [-18074.08032|16314.75558] "" Vector__XXX
 SG_ SG_FLPR : 0|16@1- (0.57582,-942.62) [-19811.08976|17925.27394] "" Vector__XXX
