VERSION ""

NS_ :

BS_:

BU_: DDU7_EGT_send

BO_ 24 DDU7_EGT_send: 8 DDU7_EGT_send
 SG_ WS_RR_DDU72M400 m3 : 39|16@0- (0.1,0) [-3276.8|3276.7] "" Vector__XXX
 SG_ WS_RL_DDU72M400 m3 : 23|16@0- (0.1,0) [-3276.8|3276.7] "" Vector__XXX
 SG_ WS_FR_DDU72M400 m2 : 39|16@0- (0.1,0) [-3276.8|3276.7] "" Vector__XXX
 SG_ WS_FL_DDU72M400 m2 : 23|16@0- (0.1,0) [-3276.8|3276.7] "" Vector__XXX
 SG_ EGT4_send m1 : 23|16@0- (0.1,0) [-3276.8|3276.7] "" Vector__XXX
 SG_ EGT3_send m0 : 55|16@0- (0.1,0) [-3276.8|3276.7] "" Vector__XXX
 SG_ EGT2_send m0 : 39|16@0- (0.1,0) [-3276.8|3276.7] "" Vector__XXX
 SG_ EGT1_send m0 : 23|16@0- (0.1,0) [-3276.8|3276.7] "" Vector__XXX
 SG_ rowcounter M : 0|8@1+ (1,0) [0|255] "" Vector__XXX
