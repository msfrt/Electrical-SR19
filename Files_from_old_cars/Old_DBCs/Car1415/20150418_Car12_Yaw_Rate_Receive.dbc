VERSION ""

NS_ :

BS_:

BU_: YRS3_Receive

BO_ 128 YRS3_Receive_80: 8 Vector__XXX
 SG_ Acc_X_YRS3_abs : 32|16@1+ (1,-32768) [-32768|32767] "" Vector__XXX
 SG_ Yaw_Angular_Acceleration_abs : 0|16@1+ (1,-32768) [-32768|32767] "" Vector__XXX

BO_ 112 YRS3_Receive_70: 8 YRS3_Receive
 SG_ Acc_Y_YRS3_abs : 32|16@1+ (1,-32768) [-32768|32767] "" Vector__XXX
 SG_ Yaw_Rate_1_abs : 0|16@1+ (1,-32768) [-32768|32767] "" Vector__XXX
