VERSION ""

NS_ :

BS_:

BU_: M400_Data2_send

BO_ 1519 M400_Data2_send: 8 M400_Data2_send
 SG_ Ign_Out4_Duty_Cycle m6 : 23|16@0- (0.1,0) [-3276.8|3276.7] "" Vector__XXX
 SG_ Ign_Out3_Duty_Cycle m5 : 55|16@0- (0.1,0) [-3276.8|3276.7] "" Vector__XXX
 SG_ Ign_Out2_Duty_Cycle m5 : 39|16@0- (0.1,0) [-3276.8|3276.7] "" Vector__XXX
 SG_ Ign_Out1_Duty_Cycle m5 : 23|16@0- (0.1,0) [-3276.8|3276.7] "" Vector__XXX
 SG_ Ignition_Advance m4 : 55|16@0- (0.1,0) [-3276.8|3276.7] "" Vector__XXX
 SG_ Inj_Out4_Duty_Cycle m4 : 39|16@0- (0.1,0) [-3276.8|3276.7] "" Vector__XXX
 SG_ Inj_Out3_Duty_Cycle m4 : 23|16@0- (0.1,0) [-3276.8|3276.7] "" Vector__XXX
 SG_ Inj_Out2_Duty_Cycle m3 : 55|16@0- (0.1,0) [-3276.8|3276.7] "" Vector__XXX
 SG_ Inj_Out1_Duty_Cycle m3 : 39|16@0- (0.1,0) [-3276.8|3276.7] "" Vector__XXX
 SG_ Fuel_Overall_Trim m3 : 23|16@0- (0.1,0) [-3276.8|3276.7] "" Vector__XXX
 SG_ Fuel_Lambda_Comp m2 : 55|16@0- (0.1,0) [-3276.8|3276.7] "" Vector__XXX
 SG_ Fuel_4_Indiv_Trim m2 : 39|16@0- (0.1,0) [-3276.8|3276.7] "" Vector__XXX
 SG_ Fuel_3_Indiv_Trim m2 : 23|16@0- (0.1,0) [-3276.8|3276.7] "" Vector__XXX
 SG_ Fuel_2_Indiv_Trim m1 : 55|16@0- (0.1,0) [-3276.8|3276.7] "" Vector__XXX
 SG_ Fuel_1_Indiv_Trim m1 : 39|16@0- (0.1,0) [-3276.8|3276.7] "" Vector__XXX
 SG_ Fuel_4_Pulse_Width m1 : 23|16@0- (0.1,0) [-3276.8|3276.7] "" Vector__XXX
 SG_ Fuel_3_Pulse_Width m0 : 55|16@0- (0.1,0) [-3276.8|3276.7] "" Vector__XXX
 SG_ Fuel_2_Pulse_Width m0 : 39|16@0- (0.1,0) [-3276.8|3276.7] "" Vector__XXX
 SG_ Fuel_1_Pulse_Width m0 : 23|16@0- (0.1,0) [-3276.8|3276.7] "" Vector__XXX
 SG_ rowcounter M : 0|8@1+ (1,0) [0|255] "" Vector__XXX
