VERSION ""

NS_ :

BS_:

BU_: DDU7

BO_ 1520 Msg_0: 8 DDU7
 SG_ Temp_M400 m2 : 55|16@0- (0.1,0) [0|0] "°" Vector__XXX
 SG_ rowcounter M : 0|8@1+ (1,0) [0|255] "" Vector__XXX
 SG_ Battery_Voltage_M400 m2 : 39|16@0- (0.01,0) [-327.68|327.67] "V" Vector__XXX
 SG_ Steering_Angle m0 : 23|16@0- (0.1,0) [-3276.8|3276.7] "°" Vector__XXX
