VERSION ""

NS_ :

BS_:

BU_: Car12_DDU7_Current_Calibrated

BO_ 153 Car12_DDU7_Current_Calibrated: 8 Car12_DDU7_Current_Calibrated
 SG_ Starter_Current_Calibrated m1 : 23|16@0- (0.1,0) [-3276.8|3276.7] "" Vector__XXX
 SG_ PDM_Neg_Current_Calibrated m0 : 55|16@0- (0.1,0) [-3276.8|3276.7] "" Vector__XXX
 SG_ Rectifer_Current_Calibrated m0 : 39|16@0- (0.1,0) [-3276.8|3276.7] "" Vector__XXX
 SG_ Pikachu_Current_Calibrated m0 : 23|16@0- (0.1,0) [-3276.8|3276.7] "" Vector__XXX
 SG_ rowcounter M : 0|8@1+ (1,0) [0|255] "" Vector__XXX
