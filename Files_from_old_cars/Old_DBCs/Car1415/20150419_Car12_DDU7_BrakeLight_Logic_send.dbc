VERSION ""

NS_ :

BS_:

BU_: Brake_Light_Logic_send

BO_ 25 Brake_Light_Logic_send: 8 Brake_Light_Logic_send
 SG_ Brake_Light_Logic_CANsend m1 : 23|16@0- (1,0) [0|0] "" Vector__XXX
 SG_ rowcounter M : 0|8@1+ (1,0) [0|255] "" Vector__XXX
