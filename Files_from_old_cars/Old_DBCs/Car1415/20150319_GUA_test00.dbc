VERSION ""

NS_ :

BS_:

BU_: DDU7

BO_ 3221225472 VECTOR__INDEPENDENT_SIG_MSG: 0 Vector__XXX
 SG_ Temp_M400 : 0|16@0- (0.1,0) [0|0] "°" Vector__XXX
 SG_ Battery_Voltage_M400 : 0|16@0- (0.01,0) [-327.68|327.67] "V" Vector__XXX

BO_ 32 Msg_0: 8 DDU7
 SG_ GUA_Temp m0 : 23|16@0- (0.01,-163.84) [0|0] "°" Vector__XXX
 SG_ rowcounter M : 0|8@1+ (1,0) [0|255] "" Vector__XXX

CM_ BO_ 3221225472 "This is a message for not used signals, created by Vector CANdb++ DBC OLE DB Provider.";
