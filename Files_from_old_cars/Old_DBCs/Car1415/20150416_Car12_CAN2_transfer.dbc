VERSION ""

NS_ :

BS_:

BU_: Car12_DDU7_CAN2_Transfer

BO_ 81 Car12_DDU7_CAN2_Transfer: 8 Car12_DDU7_CAN2_Transfer
 SG_ RPM_CAN_Trans m0 : 31|16@0- (0.1,0) [-3276.8|3276.7] "" Vector__XXX
 SG_ rowcounter M : 0|8@1+ (1,0) [0|255] "" Vector__XXX
