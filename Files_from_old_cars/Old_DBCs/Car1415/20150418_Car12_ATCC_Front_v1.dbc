VERSION ""

NS_ :

BS_:

BU_: Car12_ATCC_Front

BO_ 86 Car12_ATCC_Front: 8 Car12_ATCC_Front
 SG_ SG_p5 m3 : 55|16@0- (1,-16386) [-49154|16381] "" Vector__XXX
 SG_ SG_p4 m3 : 39|16@0- (1,-16396) [-49164|16371] "" Vector__XXX
 SG_ SG_p3 m3 : 23|16@0- (1,-16386) [-49154|16381] "" Vector__XXX
 SG_ SG_p2 m2 : 55|16@0- (1,-16386) [-49154|16381] "" Vector__XXX
 SG_ Linear_Pot_FL m2 : 39|16@0- (0.01,-163.84) [0|0] "" Vector__XXX
 SG_ Linear_Pot_FR m1 : 23|16@0- (0.01,-163.84) [0|0] "" Vector__XXX
 SG_ Tire_Temp_FRM m5 : 55|16@0- (0.01,-163.84) [0|0] "°" Vector__XXX
 SG_ Tire_Temp_FRI m0 : 39|16@0- (0.01,-163.84) [0|0] "°" Vector__XXX
 SG_ Tire_Temp_FRO m0 : 55|16@0- (0.01,-163.84) [0|0] "°" Vector__XXX
 SG_ Tire_Temp_FLO m2 : 23|16@0- (0.01,-163.84) [0|0] "°" Vector__XXX
 SG_ Tire_Temp_FLI m1 : 55|16@0- (0.01,-163.84) [0|0] "°" Vector__XXX
 SG_ Tire_Temp_FLM m1 : 39|16@0- (0.01,-163.84) [0|0] "°" Vector__XXX
 SG_ Brake_Rotor_Temp_Front m5 : 39|16@0- (0.1,-1638.4) [0|0] "°" Vector__XXX
 SG_ Brake_Press_Front m6 : 23|16@0- (1,-16384) [0|0] "PSI" Vector__XXX
 SG_ rowcounter M : 0|8@1+ (1,0) [0|255] "" Vector__XXX
