VERSION ""

NS_ :

BS_:

BU_: Car12_ATCC_Rear_v1

BO_ 32 Car12_ATCC_Rear_v1: 8 Car12_ATCC_Rear_v1
 SG_ Starter_Current m3 : 55|16@0- (0.1,-1638.4) [0|0] "" Vector__XXX
 SG_ Rectifier_Current m3 : 39|16@0- (0.1,-1638.4) [0|0] "" Vector__XXX
 SG_ PDM_NEG_Current m3 : 23|16@0- (0.1,-1638.4) [0|0] "" Vector__XXX
 SG_ Pikachu_Current m2 : 55|16@0- (0.1,-1638.4) [0|0] "" Vector__XXX
 SG_ Linear_Pot_RL m2 : 39|16@0- (0.01,-163.84) [0|0] "" Vector__XXX
 SG_ Linear_Pot_RR m1 : 23|16@0- (0.01,-163.84) [0|0] "" Vector__XXX
 SG_ Tire_Temp_RRI m5 : 55|16@0- (0.01,-163.84) [0|0] "°" Vector__XXX
 SG_ Tire_Temp_RRM m0 : 39|16@0- (0.01,-163.84) [0|0] "°" Vector__XXX
 SG_ Tire_Temp_RRO m0 : 55|16@0- (0.01,-163.84) [0|0] "°" Vector__XXX
 SG_ Tire_Temp_RLI m2 : 23|16@0- (0.01,-163.84) [0|0] "°" Vector__XXX
 SG_ Tire_Temp_RLM m1 : 55|16@0- (0.01,-163.84) [0|0] "°" Vector__XXX
 SG_ Tire_Temp_RLO m1 : 39|16@0- (0.01,-163.84) [0|0] "°" Vector__XXX
 SG_ Brake_Rotor_Temp m5 : 39|16@0- (0.1,-1638.4) [0|0] "°" Vector__XXX
 SG_ Brake_Press_Rear m6 : 23|16@0- (1,-16384) [0|0] "PSI" Vector__XXX
 SG_ Water_Outlet_Temp m6 : 39|16@0- (0.01,-163.84) [0|0] "°" Vector__XXX
 SG_ Water_Inlet_Temp m4 : 39|16@0- (0.01,-163.84) [0|0] "°" Vector__XXX
 SG_ Air_Outlet_Temp m6 : 55|16@0- (0.01,-163.84) [0|0] "°" Vector__XXX
 SG_ Air_Inlet_Temp m5 : 23|16@0- (0.01,-163.84) [0|0] "°" Vector__XXX
 SG_ rowcounter M : 0|8@1+ (1,0) [0|255] "" Vector__XXX
