VERSION ""

NS_ :

BS_:

BU_: DDU7

BO_ 1520 Msg_0: 8 DDU7
 SG_ rowcounter M : 0|8@1+ (1,0) [0|255] "" Vector__XXX
 SG_ Fuel_Temp m13 : 23|16@0- (0.1,0) [-3276.8|3276.7] "°C" Vector__XXX
 SG_ Lambda_1_Long_Term_Trim m12 : 55|16@0- (1,0) [0|0] "" Vector__XXX
 SG_ Lambda_1_Short_Term_Trim m12 : 39|16@0- (1,0) [0|0] "" Vector__XXX
 SG_ Lambda_1_Aim_Value m12 : 23|16@0- (1,0) [0|0] "" Vector__XXX
 SG_ TC_Slip_Aim_Value m11 : 55|16@0- (1,0) [0|0] "" Vector__XXX
 SG_ TC_Slip_Aim_Error m11 : 39|16@0- (1,0) [0|0] "" Vector__XXX
 SG_ Ign_Cut_Level_Total m11 : 23|16@0- (1,0) [0|0] "" Vector__XXX
 SG_ Fuel_Inj_Duty_Cycle m10 : 55|16@0- (1,0) [0|0] "%" Vector__XXX
 SG_ TC_Cut_Level m10 : 39|16@0- (1,0) [0|0] "%" Vector__XXX
 SG_ Ground_Speed_Right m10 : 23|16@0- (1,0) [0|0] "km/h" Vector__XXX
 SG_ Ground_Speed_Left m9 : 55|16@0- (1,0) [0|0] "km/h" Vector__XXX
 SG_ Drive_Speed_Right m9 : 39|16@0- (1,0) [0|0] "km/h" Vector__XXX
 SG_ Drive_Speed_Left m9 : 23|16@0- (1,0) [0|0] "km/h" Vector__XXX
 SG_ Exhaust_Gas_Temp_4 m8 : 55|16@0- (1,0) [0|0] "°C" Vector__XXX
 SG_ Exhaust_Gas_Temp_3 m8 : 39|16@0- (1,0) [0|0] "°C" Vector__XXX
 SG_ Exhaust_Gas_Temp_2 m8 : 23|16@0- (1,0) [0|0] "°C" Vector__XXX
 SG_ Exhaust_Gas_Temp_1 m7 : 55|16@0- (1,0) [0|0] "°C" Vector__XXX
 SG_ G_Lateral m7 : 39|16@0- (0.001,0) [-32.768|32.767] "g" Vector__XXX
 SG_ Lambda_1 m7 : 23|16@0- (0.001,0) [-32.768|32.767] "" Vector__XXX
 SG_ Manifold_Pressure m6 : 55|16@0- (0.1,0) [-3276.8|3276.7] "" Vector__XXX
 SG_ Wheel_Slip m6 : 39|16@0- (1,0) [0|0] "" Vector__XXX
 SG_ Fuel_Cut_Level_Total m6 : 23|16@0- (1,0) [0|0] "%" Vector__XXX
 SG_ Throttle_Position m5 : 55|16@0- (0.1,0) [0|0] "%" Vector__XXX
 SG_ RPM m5 : 39|16@0- (1,0) [0|0] "" Vector__XXX
 SG_ Oil_Temp m5 : 23|16@0- (0.1,0) [-3276.8|3276.7] "°C" Vector__XXX
 SG_ Oil_pressure m4 : 55|16@0- (0.1,0) [-3276.8|3276.7] "psi" Vector__XXX
 SG_ G_Longitudinal m4 : 39|16@0- (0.001,0) [-32.768|32.767] "g" Vector__XXX
 SG_ Inlet_Air_Temp m4 : 23|16@0- (0.1,0) [-3276.8|3276.7] "°C" Vector__XXX
 SG_ Gear m3 : 55|16@0- (1,0) [0|0] "" Vector__XXX
 SG_ Fuel_Pressure m3 : 39|16@0- (0.1,0) [-3276.8|3276.7] "psi" Vector__XXX
 SG_ Engine_Temp m3 : 23|16@0- (0.1,0) [-3276.8|3276.7] "°C" Vector__XXX
 SG_ ECU_Temp m2 : 55|16@0- (0.1,0) [0|0] "°C" Vector__XXX
 SG_ Battery_Voltage_M400 m2 : 39|16@0- (0.01,0) [-327.68|327.67] "V" Vector__XXX
 SG_ AUX8_Duty_Cycle_M400 m2 : 23|16@0- (1,0) [0|0] "%" Vector__XXX
 SG_ AUX7_Duty_Cycle_M400 m1 : 55|16@0- (1,0) [0|0] "%" Vector__XXX
 SG_ AUX6_Duty_Cycle_M400 m1 : 39|16@0- (1,0) [0|0] "%" Vector__XXX
 SG_ AUX5_Duty_Cycle_M400 m1 : 23|16@0- (1,0) [0|0] "%" Vector__XXX
 SG_ AUX4_Duty_Cycle_M400 m0 : 55|16@0- (1,0) [0|0] "%" Vector__XXX
 SG_ AUX3_Duty_Cycle_M400 m0 : 39|16@0- (1,0) [0|0] "%" Vector__XXX
 SG_ Steering_Angle m0 : 23|16@0- (0.1,0) [-3276.8|3276.7] "°" Vector__XXX
